## haptic-mouse-firmware/main/Kconfig.projbuild
```kconfig
menu "Haptic Mouse Configuration"

    orsource "$IDF_PATH/examples/common_components/env_caps/$IDF_TARGET/Kconfig.env_caps"

    config BLINK_GPIO
        int "Blink GPIO number"
        range ENV_GPIO_RANGE_MIN ENV_GPIO_OUT_RANGE_MAX
        default 48
        help
            GPIO number (IOxx) to blink on and off the LED.
            Some GPIOs are used for other purposes (flash connections, etc.) and cannot be used to blink.

    config BLINK_PERIOD
        int "Blink period in ms"
        range 10 3600000
        default 1000
        help
            Define the blinking period in milliseconds.

    config MAX98357A_LRC_GPIO
        int "MAX98357A LRC GPIO number"
        range ENV_GPIO_RANGE_MIN ENV_GPIO_OUT_RANGE_MAX
        default 1
        help
            GPIO number (IOxx) to connect to the LRC pin of the MAX98357A amplifier.
    
    config MAX98357A_BCLK_GPIO
        int "MAX98357A BCLK GPIO number"
        range ENV_GPIO_RANGE_MIN ENV_GPIO_OUT_RANGE_MAX
        default 2
        help
            GPIO number (IOxx) to connect to the BCLK pin of the MAX98357A amplifier.
    
    config MAX98357A_DIN_GPIO
        int "MAX98357A DIN GPIO number"
        range ENV_GPIO_RANGE_MIN ENV_GPIO_OUT_RANGE_MAX
        default 4
        help
            GPIO number (IOxx) to connect to the DIN pin of the MAX98357A amplifier.

endmenu
```

## haptic-mouse-firmware/sdkconfig.defaults
```kconfig
CONFIG_ESP_CONSOLE_SECONDARY_NONE=y
CONFIG_PARTITION_TABLE_CUSTOM=y
CONFIG_PARTITION_TABLE_CUSTOM_FILENAME="partitions.csv"
```
